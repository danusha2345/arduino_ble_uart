## esp-idf-v6/main/Kconfig.projbuild
```kconfig
menu "GNSS BLE Bridge Configuration"

    choice TARGET_BOARD
        prompt "Выберите целевую плату"
        default TARGET_ESP32_C3
        help
            Выберите плату ESP32 для компиляции

        config TARGET_ESP32_C3
            bool "ESP32-C3 Super Mini"
        config TARGET_ESP32_C6
            bool "ESP32-C6 Tenstar SuperMini"
        config TARGET_ESP32_S3
            bool "ESP32-S3-Zero"
    endchoice

    config WIFI_SSID
        string "WiFi SSID для AP режима"
        default "UM980_GPS_BRIDGE"
        help
            SSID для WiFi точки доступа

    config WIFI_PASSWORD
        string "WiFi пароль"
        default "123456789"
        help
            Пароль для WiFi точки доступа

    config GPS_UART_BAUD_RATE
        int "UART скорость для GPS"
        default 460800
        help
            Скорость UART для GPS модуля

    menu "Пины для ESP32-C3"
        depends on TARGET_ESP32_C3

        config C3_UART_RX_PIN
            int "UART RX пин"
            default 8

        config C3_UART_TX_PIN
            int "UART TX пин"
            default 10

        config C3_I2C_SDA_PIN
            int "I2C SDA пин"
            default 3

        config C3_I2C_SCL_PIN
            int "I2C SCL пин"
            default 4

        config C3_SPI_MOSI_PIN
            int "SPI MOSI пин"
            default 1

        config C3_SPI_SCLK_PIN
            int "SPI SCLK пин"
            default 0

        config C3_TFT_DC_PIN
            int "TFT DC пин"
            default 2

        config C3_TFT_RST_PIN
            int "TFT RST пин"
            default 9

        config C3_TFT_BL_PIN
            int "TFT Backlight пин"
            default 5
    endmenu

    menu "Пины для ESP32-C6 Tenstar SuperMini"
        depends on TARGET_ESP32_C6

        config C6_UART_RX_PIN
            int "UART RX пин"
            default 6
            help
                GPIO6 - UART RX для GPS модуля

        config C6_UART_TX_PIN
            int "UART TX пин"
            default 7
            help
                GPIO7 - UART TX для GPS модуля

        config C6_SPI_MOSI_PIN
            int "SPI MOSI пин"
            default 18
            help
                GPIO18 - SPI MOSI для TFT дисплея ST7789V

        config C6_SPI_SCLK_PIN
            int "SPI SCLK пин"
            default 19
            help
                GPIO19 - SPI Clock для TFT дисплея

        config C6_TFT_DC_PIN
            int "TFT DC пин"
            default 20
            help
                GPIO20 - Data/Command для TFT дисплея

        config C6_TFT_RST_PIN
            int "TFT RST пин"
            default 21
            help
                GPIO21 - Reset для TFT дисплея

        config C6_TFT_BL_PIN
            int "TFT Backlight пин"
            default 22
            help
                GPIO22 - Backlight для TFT дисплея

        config C6_LED_PIN
            int "Адресный LED пин"
            default 8
            help
                GPIO8 - WS2812 адресный светодиод

        config C6_LED_PIN_2
            int "Обычный LED пин"
            default 15
            help
                GPIO15 - Обычный светодиод
    endmenu

    menu "Пины для ESP32-S3"
        depends on TARGET_ESP32_S3

        config S3_UART_RX_PIN
            int "UART RX пин"
            default 5

        config S3_UART_TX_PIN
            int "UART TX пин"
            default 6

        config S3_I2C_SDA_PIN
            int "I2C SDA пин"
            default 2

        config S3_I2C_SCL_PIN
            int "I2C SCL пин"
            default 1

        config S3_SPI_MOSI_PIN
            int "SPI MOSI пин"
            default 11

        config S3_SPI_SCLK_PIN
            int "SPI SCLK пин"
            default 12

        config S3_TFT_DC_PIN
            int "TFT DC пин"
            default 9

        config S3_TFT_RST_PIN
            int "TFT RST пин"
            default 10

        config S3_TFT_BL_PIN
            int "TFT Backlight пин"
            default 13
    endmenu

endmenu
```

## esp-idf-v6/sdkconfig.defaults
```kconfig
# Bluetooth Configuration
CONFIG_BT_ENABLED=y
CONFIG_BT_NIMBLE_ENABLED=y
CONFIG_BT_CONTROLLER_ENABLED=y
CONFIG_BT_NIMBLE_MAX_CONNECTIONS=1

# ESP32-C6 specific
CONFIG_BT_LE_CONTROLLER_LOG_ENABLED=n

# Partition Table
CONFIG_PARTITION_TABLE_CUSTOM=y
CONFIG_PARTITION_TABLE_CUSTOM_FILENAME="partitions.csv"
CONFIG_PARTITION_TABLE_FILENAME="partitions.csv"
```

## esp-idf-v6/sdkconfig.defaults.esp32c3
```kconfig
# ESP32-C3 Configuration

# Target configuration
CONFIG_IDF_TARGET="esp32c3"
CONFIG_IDF_TARGET_ESP32C3=y

# Application configuration
CONFIG_TARGET_ESP32_C3=y

# BLE/Bluetooth configuration
CONFIG_BT_ENABLED=y
CONFIG_BT_NIMBLE_ENABLED=y
CONFIG_BTDM_CTRL_MODE_BLE_ONLY=y
CONFIG_BTDM_CTRL_MODE_BR_EDR_ONLY=n
CONFIG_BTDM_CTRL_MODE_BTDM=n
CONFIG_BT_NIMBLE_MAX_CONNECTIONS=4
CONFIG_BT_NIMBLE_ATT_PREFERRED_MTU=517
CONFIG_BT_NIMBLE_ROLE_PERIPHERAL=y
CONFIG_BT_NIMBLE_ROLE_CENTRAL=n

# WiFi configuration
CONFIG_ESP32_WIFI_STATIC_RX_BUFFER_NUM=10
CONFIG_ESP32_WIFI_DYNAMIC_RX_BUFFER_NUM=32
CONFIG_ESP32_WIFI_DYNAMIC_TX_BUFFER_NUM=32

# FreeRTOS configuration
CONFIG_FREERTOS_HZ=1000
CONFIG_FREERTOS_UNICORE=y

# UART configuration
CONFIG_UART_ISR_IN_IRAM=y

# SPI configuration
CONFIG_SPI_MASTER_IN_IRAM=y

# Logging
CONFIG_LOG_DEFAULT_LEVEL_INFO=y
CONFIG_LOG_MAXIMUM_LEVEL_VERBOSE=y

# Memory
CONFIG_ESP_SYSTEM_ALLOW_RTC_FAST_MEM_AS_HEAP=y

# Performance
CONFIG_COMPILER_OPTIMIZATION_PERF=y
CONFIG_ESP32C3_DEFAULT_CPU_FREQ_160=y
```

## esp-idf-v6/sdkconfig.defaults.esp32c6
```kconfig
# ESP32-C6 Configuration

# Target configuration
CONFIG_IDF_TARGET="esp32c6"
CONFIG_IDF_TARGET_ESP32C6=y

# Application configuration
CONFIG_TARGET_ESP32_C6=y

# Flash configuration (4MB)
CONFIG_ESPTOOLPY_FLASHSIZE_4MB=y
CONFIG_ESPTOOLPY_FLASHSIZE="4MB"
CONFIG_PARTITION_TABLE_CUSTOM_FILENAME="partitions.csv"
CONFIG_PARTITION_TABLE_FILENAME="partitions.csv"

# BLE/Bluetooth configuration
CONFIG_BT_ENABLED=y
CONFIG_BT_NIMBLE_ENABLED=y
CONFIG_BT_CONTROLLER_ENABLED=y
CONFIG_BT_NIMBLE_MAX_CONNECTIONS=4
CONFIG_BT_NIMBLE_ATT_PREFERRED_MTU=517
CONFIG_BT_NIMBLE_ROLE_PERIPHERAL=y
CONFIG_BT_NIMBLE_ROLE_CENTRAL=n

# WiFi configuration (802.11ax support)
CONFIG_ESP_WIFI_ENABLE_WIFI6=y
CONFIG_ESP32_WIFI_STATIC_RX_BUFFER_NUM=10
CONFIG_ESP32_WIFI_DYNAMIC_RX_BUFFER_NUM=32
CONFIG_ESP32_WIFI_DYNAMIC_TX_BUFFER_NUM=32

# FreeRTOS configuration
CONFIG_FREERTOS_HZ=1000
CONFIG_FREERTOS_UNICORE=y

# UART configuration
CONFIG_UART_ISR_IN_IRAM=y

# SPI configuration
CONFIG_SPI_MASTER_IN_IRAM=y

# Logging
CONFIG_LOG_DEFAULT_LEVEL_INFO=y
CONFIG_LOG_MAXIMUM_LEVEL_VERBOSE=y

# Performance
CONFIG_COMPILER_OPTIMIZATION_PERF=y
CONFIG_ESP32C6_DEFAULT_CPU_FREQ_160=y
```

## esp-idf-v6/sdkconfig.defaults.esp32s3
```kconfig
# ESP32-S3 Configuration

# Target configuration
CONFIG_IDF_TARGET="esp32s3"
CONFIG_IDF_TARGET_ESP32S3=y

# Application configuration
CONFIG_TARGET_ESP32_S3=y

# Dual-core configuration
CONFIG_FREERTOS_UNICORE=n

# PSRAM configuration
CONFIG_ESP32S3_SPIRAM_SUPPORT=y
CONFIG_SPIRAM_MODE_OCT=y
CONFIG_SPIRAM_SPEED_80M=y
CONFIG_SPIRAM_USE_MALLOC=y

# BLE/Bluetooth configuration
CONFIG_BT_ENABLED=y
CONFIG_BT_NIMBLE_ENABLED=y
CONFIG_BTDM_CTRL_MODE_BLE_ONLY=y
CONFIG_BTDM_CTRL_MODE_BR_EDR_ONLY=n
CONFIG_BTDM_CTRL_MODE_BTDM=n
CONFIG_BT_NIMBLE_MAX_CONNECTIONS=4
CONFIG_BT_NIMBLE_ATT_PREFERRED_MTU=517
CONFIG_BT_NIMBLE_ROLE_PERIPHERAL=y
CONFIG_BT_NIMBLE_ROLE_CENTRAL=n
CONFIG_BT_NIMBLE_PINNED_TO_CORE_0=y

# WiFi configuration
CONFIG_ESP32_WIFI_STATIC_RX_BUFFER_NUM=10
CONFIG_ESP32_WIFI_DYNAMIC_RX_BUFFER_NUM=32
CONFIG_ESP32_WIFI_DYNAMIC_TX_BUFFER_NUM=32
CONFIG_ESP_WIFI_TASK_PINNED_TO_CORE_0=y

# FreeRTOS configuration
CONFIG_FREERTOS_HZ=1000
CONFIG_FREERTOS_UNICORE=n

# UART configuration
CONFIG_UART_ISR_IN_IRAM=y

# SPI configuration
CONFIG_SPI_MASTER_IN_IRAM=y

# Logging
CONFIG_LOG_DEFAULT_LEVEL_INFO=y
CONFIG_LOG_MAXIMUM_LEVEL_VERBOSE=y

# Memory
CONFIG_ESP_SYSTEM_ALLOW_RTC_FAST_MEM_AS_HEAP=y

# Performance
CONFIG_COMPILER_OPTIMIZATION_PERF=y
CONFIG_ESP32S3_DEFAULT_CPU_FREQ_240=y

# USB CDC (для отладки через USB)
CONFIG_ESP_CONSOLE_USB_CDC=y
```
